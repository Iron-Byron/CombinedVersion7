## build_1/Kconfig/Kconfig.shield
```kconfig
osource "c:/ncs/my_boards/boards/shields/*/Kconfig.shield"
osource "c:/ncs/v2.6.1/my_apps/pcb_code/large+smallprobe/boards/shields/*/Kconfig.shield"
osource "c:/ncs/v2.6.1/my_apps/pcb_code/large_smallcode/boards/shields/*/Kconfig.shield"
osource "c:/ncs/v2.6.1/my_apps/pcb_code/combined_ble_gatt/boards/shields/*/Kconfig.shield"
osource "c:/ncs/v2.6.1/my_apps/pcb_code/combined_ble_gatt2/boards/shields/*/Kconfig.shield"
osource "c:/ncs/v2.6.1/my_apps/pcb_code/combined_ble_gatt3/boards/shields/*/Kconfig.shield"
osource "c:/ncs/v2.6.1/my_apps/pcb_code/combined_ble_gatt4/boards/shields/*/Kconfig.shield"
osource "c:/ncs/v2.6.1/my_apps/pcb_code/combined_ble_gatt5/boards/shields/*/Kconfig.shield"
osource "c:/ncs/v2.6.1/my_apps/pcb_code/combined_ble_gatt6/boards/shields/*/Kconfig.shield"
osource "c:/ncs/v2.6.1/my_apps/pcb_code/combined_ble_gatt7/boards/shields/*/Kconfig.shield"
osource "C:/ncs/v2.6.1/nrf/boards/shields/*/Kconfig.shield"
```

## build_1/Kconfig/Kconfig.shield.defconfig
```kconfig
osource "c:/ncs/my_boards/boards/shields/*/Kconfig.defconfig"
osource "c:/ncs/v2.6.1/my_apps/pcb_code/large+smallprobe/boards/shields/*/Kconfig.defconfig"
osource "c:/ncs/v2.6.1/my_apps/pcb_code/large_smallcode/boards/shields/*/Kconfig.defconfig"
osource "c:/ncs/v2.6.1/my_apps/pcb_code/combined_ble_gatt/boards/shields/*/Kconfig.defconfig"
osource "c:/ncs/v2.6.1/my_apps/pcb_code/combined_ble_gatt2/boards/shields/*/Kconfig.defconfig"
osource "c:/ncs/v2.6.1/my_apps/pcb_code/combined_ble_gatt3/boards/shields/*/Kconfig.defconfig"
osource "c:/ncs/v2.6.1/my_apps/pcb_code/combined_ble_gatt4/boards/shields/*/Kconfig.defconfig"
osource "c:/ncs/v2.6.1/my_apps/pcb_code/combined_ble_gatt5/boards/shields/*/Kconfig.defconfig"
osource "c:/ncs/v2.6.1/my_apps/pcb_code/combined_ble_gatt6/boards/shields/*/Kconfig.defconfig"
osource "c:/ncs/v2.6.1/my_apps/pcb_code/combined_ble_gatt7/boards/shields/*/Kconfig.defconfig"
osource "C:/ncs/v2.6.1/nrf/boards/shields/*/Kconfig.defconfig"
```
